/*
 * Copyright (c) 2024 Klaus Nagel, <nagelkl01@gmail.com>
 *
 * SPDX-License-Identifier: Apache-2.0
 */

/ {
    soc {
        i2s0: i2s0@42005000 {
	        compatible = "atmel,i2s-sam0";
	        #address-cells = <1>;
	        #size-cells = <0>;
	        reg = <0x42005000 0x400>;
	        interrupts = <27 0>;
			clocks = <&gclk 35>, <&pm 0x20 20>;
			clock-names = "GCLK", "PM";
			atmel,assigned-clocks = <&gclk 0>;
			atmel,assigned-clock-names = "GCLK";
            dmas = <&dmac 0 41>,  
            		<&dmac 1 43>;
            dma-names = "rx", "tx";
	        status = "disabled";
			no-mck;
        };
	};
};