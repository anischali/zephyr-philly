## app/boards/atmel/samd21/samd21_defconfig
```kconfig
CONFIG_SOC_ATMEL_SAMD_OSC8M=y
CONFIG_SOC_ATMEL_SAMD_OSC8M_AS_MAIN=y
CONFIG_SPI=y
CONFIG_GPIO=y

# console configs
CONFIG_CONSOLE=y
CONFIG_SERIAL=y
CONFIG_UART_CONSOLE=y
CONFIG_UART_INTERRUPT_DRIVEN=y

# sound configs
CONFIG_I2S=y
CONFIG_AUDIO=y
CONFIG_I2S_SAM0=y
```

## app/boards/stm32/stm32g071kb/Kconfig.stm32g071xx
```kconfig
# Copyright (c) 2024 Klaus Nagel <nagelkl01@gmail.com>
# SPDX-License-Identifier: Apache-2.0

config BOARD_STM32G071XX
	select SOC_STM32G071XX
```

## app/boards/stm32/stm32g071kb/board.yml
```yaml
board:
  name: stm32g071xx
  full_name: STM32G071XX based board
  vendor: st
  socs:
    - name: stm32g071xx
```

## app/drivers/Kconfig
```kconfig
# SPDX-License-Identifier: Apache-2.0

menu "Drivers"
rsource "i2s/Kconfig"
endmenu
```

## app/drivers/i2s/Kconfig
```kconfig
# SPDX-License-Identifier: Apache-2.0

# Atmel SAM0 I2S bus driver configuration options
# SPDX-License-Identifier: Apache-2.0

menuconfig I2S
	bool "I2S (I2S) Bus Drivers"
	help
	  Enable Inter Sound (I2S) bus drivers..

if I2S

module = I2S
module-str = I2S
source "subsys/logging/Kconfig.template.log_config"

rsource 'Kconfig.sam0_i2s'

endif # SAM0_I2S
```

## app/drivers/i2s/Kconfig.i2s_sam0
```kconfig
config I2S_SAM0
	bool "Atmel SAM0 MCU family I2S (I2S) Bus Driver"
	default y
	depends on DT_HAS_ATMEL_I2S_SAM0_ENABLED
	select PINCTRL
	select DMA
	help
	  Enable Inter Sound (I2S) bus driver for Atmel SAM0 MCU family based on
	  Synchronous Serial Controller (I2S) module.

config I2S_SAM0_RX_BLOCK_COUNT
	int "RX queue length"
	default 4

config I2S_SAM0_TX_BLOCK_COUNT
	int "TX queue length"
	default 4
```

## drivers/Kconfig
```kconfig
# SPDX-License-Identifier: Apache-2.0

menu "drivers"
rsource "i2s/Kconfig"
endmenu
```

## drivers/i2s/Kconfig
```kconfig
# SPDX-License-Identifier: Apache-2.0

# Atmel SAM0 I2S bus driver configuration options
# SPDX-License-Identifier: Apache-2.0

menuconfig I2S
	bool "I2S (I2S) Bus Drivers"
	help
	  Enable Inter Sound (I2S) bus drivers..

if I2S

rsource 'Kconfig.sam0_i2s'

endif # SAM0_I2S
```

## philly/boards/atmel/samd21/board.yml
```yaml
board:
  name: samd21
  full_name: SAM D21 custom board
  vendor: atmel
  socs:
    - name: samd21g18a
```

## philly/boards/atmel/samd21/samd21_defconfig
```kconfig
CONFIG_SOC_ATMEL_SAMD_OSC8M=y
CONFIG_SOC_ATMEL_SAMD_OSC8M_AS_MAIN=y
CONFIG_SERIAL=y
CONFIG_SPI=y
CONFIG_CONSOLE=y
CONFIG_UART_CONSOLE=y
CONFIG_UART_INTERRUPT_DRIVEN=y
```

## west.yml
```yaml
manifest:
  self:
    west-commands: scripts/west-commands.yml  

  remotes:
    - name: zephyrproject-rtos
      url-base: https://github.com/zephyrproject-rtos

  projects:
    - name: zephyr
      remote: zephyrproject-rtos
      revision: refs/tags/v4.0.0
      import:
        name-allowlist:
          - cmsis      # required by the ARM port
          - hal_atmel  # required by the samd21 board (Atmel)
          - hal_stm32  # required by the stm32g071kb board (STM32 based)
```

## zephyr/west.yml
```yaml
manifest:
  self:
    west-commands: scripts/west-commands.yml

  remotes:
    - name: zephyrproject-rtos
      url-base: https://github.com/zephyrproject-rtos

  projects:
    - name: zephyr
      remote: zephyrproject-rtos
      revision: refs/tags/v4.0.0
      import: true
```
